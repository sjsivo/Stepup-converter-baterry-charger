////#include <Adafruit_GFX.h>    // Core graphics library
////#include <Adafruit_ST7735.h> // Hardware-specific library for ST7735
//#include <Adafruit_ST7789.h> // Hardware-specific library for ST7789
////#include <Fonts/FreeSans12pt7b.h>
////#include <Fonts/FreeSerifItalic9pt7b.h>
#include <SPI.h>


  // For the breakout board, you can use any 2 or 3 pins.
  // These pins will also work for the 1.8" TFT shield.
  ////#define TFT_CS        22
  ////#define TFT_RST        18 // Or set to -1 and connect to Arduino RESET pin
  ////#define TFT_DC         21
// OPTION 2 lets you interface the display using ANY TWO or THREE PINS,
// tradeoff being that performance is not as fast as hardware SPI above.
////#define TFT_MOSI 23  // Data out
////#define TFT_SCLK 19  // Clock out

// OPTION 1 (recommended) is to use the HARDWARE SPI pins, which are unique
// to each board and not reassignable. For Arduino Uno: MOSI = pin 11 and
// SCLK = pin 13. This is the fastest mode of operation and is required if
// using the breakout board's microSD card.

// For 1.44" and 1.8" TFT with ST7735 use:
////Adafruit_ST7735 tft = Adafruit_ST7735(TFT_CS, TFT_DC,TFT_MOSI,TFT_SCLK ,TFT_RST);

// For 1.14", 1.3", 1.54", and 2.0" TFT with ST7789:
//Adafruit_ST7789 tft = Adafruit_ST7789(TFT_CS, TFT_DC, TFT_RST);




// For ST7735-based displays, we will use this call
//Adafruit_ST7735 tft = Adafruit_ST7735(TFT_CS, TFT_DC, TFT_MOSI, TFT_SCLK, TFT_RST);

// OR for the ST7789-based displays, we will use this call
//Adafruit_ST7789 tft = Adafruit_ST7789(TFT_CS, TFT_DC, TFT_MOSI, TFT_SCLK, TFT_RST);


float p = 3.1415926;
float beforevolt=0;
unsigned int ADC_VALUE = 0;
unsigned int ADC_VALUE2 = 0;
unsigned int ADC_VALUE3 = 0;
unsigned int currentstep=1;
unsigned char currentmode=0;
unsigned char currentval=0;
unsigned long beforemillis=0;
#include <EasyButton.h>

// Arduino pin where the buttons are connected to
#define BUTTON_TWO_PIN 14
#define BUTTON_THREE_PIN 32


EasyButton button2(BUTTON_TWO_PIN);
// Buttons
EasyButton button3(BUTTON_THREE_PIN);


 //Callibrated ADC
const float ADC_LUT[4096] = { 0,
96.8000,97.8000,98.8000,100.0000,101.0000,102.0000,103.0000,104.0000,105.2000,106.4000,107.4000,108.6000,109.8000,110.8000,111.8000,
113.0000,114.4000,115.8000,117.0000,118.6000,119.8000,121.2000,122.8000,124.0000,125.4000,126.8000,128.0000,129.0000,130.0000,131.0000,
132.0000,133.0000,134.0000,135.0000,136.0000,137.0000,138.0000,139.0000,140.0000,141.0000,142.0000,143.0000,144.0000,145.6000,146.8000,
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4071.8000,4072.2000,4073.0000,4073.6001,4074.0000,4074.8000,4075.0000,4075.8000,4076.3999,4077.0000,4077.8000,4078.0000,4078.8000,4079.2000,4080.00
};

#include <Arduino.h>
#include <U8g2lib.h>

#ifdef U8X8_HAVE_HW_SPI
#include <SPI.h>
#endif
#ifdef U8X8_HAVE_HW_I2C
#include <Wire.h>
#endif

U8G2_PCD8544_84X48_F_4W_SW_SPI u8g2(U8G2_R0, /* clock=*/ 33, /* data=*/ 25, /* cs=*/ 19, /* dc=*/ 12, /* reset=*/ 17);  // Nokia 5110 Display

void setup() {
  // put your setup code here, to run once:
  Serial.begin(115200);
  pinMode(27, INPUT);
  pinMode(21, OUTPUT);


  button2.begin();
  button3.begin();  
  button2.onPressed(onButton2Pressed);
  button3.onPressed(onButton3Pressed);
  //       analogSetAttenuation(26,ADC_0db);
  ////digitalWrite(32,LOW);
  // analogSetSamples(12);
  analogSetClockDiv(64);
  analogSetCycles(32);
  analogSetPinAttenuation(27, ADC_0db);
analogSetPinAttenuation(13, ADC_11db);
analogSetPinAttenuation(26, ADC_0db);
   ledcSetup(0, 65000, 10);
   ledcAttachPin(21, 0);
   currentstep=1;
ledcWrite(0, currentstep); //0% pwm
     ////tft.initR(INITR_BLACKTAB);      // Init ST7735S chip, black tab
////tft.setRotation(1);
  Serial.println(F("Initialized"));

////  uint16_t time = millis();
  ////tft.fillScreen(ST77XX_BLACK);
  ////time = millis() - time;

 //// Serial.println(time, DEC);

    ////tft.fillScreen(ST77XX_BLACK);
////  testdrawtext("Sktechnologie 2021 Sivak", ST77XX_BLUE);
  u8g2.begin();
 
  u8g2.setFont(u8g2_font_6x10_tf);
  u8g2.setFontRefHeightExtendedText();
  u8g2.setDrawColor(1);
  u8g2.setFontPosTop();
  u8g2.setFontDirection(0);

  u8g2.clearBuffer();
  u8g2.drawStr( 0, 0, "Sivak Charger.");
  u8g2.sendBuffer();
  
  beforemillis=millis();
}


// Callback function to be called when button2 is pressed
void onButton2Pressed() {
  Serial.println("Button2 has been pressed!");
  //ledcWrite(0, 338);
   currentmode=currentmode+1;
   if (currentmode>2)
   {
    Serial.println("[OFF][][]");
    currentmode=0;
   }
   if (currentmode==1) Serial.println("[][CV][]");
   if (currentmode==2) Serial.println("[][][CC]");
   currentval=0;
}

// Callback function to be called when button3 is pressed
void onButton3Pressed() {
  Serial.println("Button3 has been pressed!");
   //ledcWrite(0, 512);
   currentval=currentval+1;

   if (currentval>2)
   {
    if (currentmode==1) Serial.println("<0V><><>");
    if (currentmode==2) Serial.println("<0A><><>");
    currentval=0;
   }
   if ((currentmode==1)&&(currentval==1)) Serial.println("<><12.6V><>");
   if ((currentmode==1)&&(currentval==2)) Serial.println("<><><13.3V>");
   if ((currentmode==2)&&(currentval==1)) Serial.println("<><0.1A><>");
   if ((currentmode==2)&&(currentval==2)) Serial.println("<><><0.3A>");
}




void testdrawtext(char *text, uint16_t color) {
  ////tft.setCursor(0, 0);
  ////tft.setTextColor(color);
  ////tft.setTextWrap(true);
  ////tft.print(text);
}


void loop() {
  // put your main code here, to run repeatedly:
  button2.read();
  button3.read();

  ADC_VALUE=0;
  for (int i=0;i<16;i++)
  {
   ADC_VALUE +=(int)ADC_LUT[analogRead(27)];
  }
  ADC_VALUE=ADC_VALUE/16;

  ADC_VALUE2 =0;
  for (int i=0;i<16;i++)
  {
   ADC_VALUE2 += (int)ADC_LUT[analogRead(13)];
  }
  ADC_VALUE2=ADC_VALUE2/16;
  ADC_VALUE2-=2020;

    ADC_VALUE3 =0;
  for (int i=0;i<16;i++)
  {
   ADC_VALUE3 += (int)ADC_LUT[analogRead(26)];
  }
  ADC_VALUE3=ADC_VALUE3/16;
 float voltage_value =((float)ADC_VALUE * 0.0050 ); //20.27 18.097* ((float)ADC_VALUE * 1.1 ) / (4095)
  float voltage_value2 = ((float)ADC_VALUE2 * 0.037 );//0.38; (((float)ADC_VALUE2 * 1.1 ) / (4095))/0.18
  float voltage_value3 = ((float)ADC_VALUE3 * 0.0051 );//0.38; (((float)ADC_VALUE2 * 1.1 ) / (4095))/0.18  
  if (((voltage_value2>2.5)&&(voltage_value2<100))||(voltage_value<2.6)||(voltage_value3>19)||(voltage_value>19))
  {
    Serial.println("Overload error!!!");
    currentmode=0;
    currentval=0;
     Serial.print("Voltage = ");
  Serial.print(voltage_value,2);
  Serial.println("V");
  Serial.print("Current = ");
  Serial.print(voltage_value2,2);
  Serial.println("A");
  Serial.print("VoltageBatt = ");
  Serial.print(voltage_value3,2);
  Serial.println("V");
  Serial.print("Current DAC=");
  Serial.println(currentstep);
  }
if ((millis()-1000)>beforemillis)
{
  if (currentmode==0) Serial.println("[OFF][][]");
     if (currentmode==1) Serial.println("[][CV][]");
   if (currentmode==2) Serial.println("[][][CC]");
     if ((currentmode==1)&&(currentval==1)) Serial.println("<><12.6V><>");
   if ((currentmode==1)&&(currentval==2)) Serial.println("<><><13.3V>");
   if ((currentmode==2)&&(currentval==1)) Serial.println("<><0.2A><>");
   if ((currentmode==2)&&(currentval==2)) Serial.println("<><><0.5A>");
  Serial.print("ADC VALUE = ");
  Serial.println(ADC_VALUE);
  Serial.print("ADC VALUE = ");
  Serial.println(ADC_VALUE2);
  //delay(1000);
 
  Serial.print("Voltage = ");
  Serial.print(voltage_value,2);
  Serial.println("V");
  Serial.print("Current = ");
  Serial.print(voltage_value2,2);
  Serial.println("A");
  Serial.print("VoltageBatt = ");
  Serial.print(voltage_value3,2);
  Serial.println("V");
  Serial.print("Current DAC=");
  Serial.println(currentstep);

    u8g2.clearBuffer();
  u8g2.drawStr( 0, 0, "Sivak Charger.");
  u8g2.setCursor(0,10);
  u8g2.print(voltage_value,2);
  u8g2.print("V");
   if (currentmode==0) 
    {
      u8g2.setCursor(35,10);
      u8g2.print("OFF");
    } 
    if (currentmode==1) 
    {
      u8g2.setCursor(40,10);
      u8g2.print("CV");
      if (currentval==1) 
      {
        u8g2.setCursor(40,20);
      u8g2.print("12.6V");
      }
      if (currentval==2) 
      {
        u8g2.setCursor(40,20);
      u8g2.print("13.3V");
      }
    }
        if (currentmode==2) 
    {
      u8g2.setCursor(40,10);
      u8g2.print("CC");
      if (currentval==1) 
      {
        u8g2.setCursor(40,20);
      u8g2.print("0.2A");
      }
      if (currentval==2) 
      {
        u8g2.setCursor(40,20);
      u8g2.print("0.5A");
      }
    }
  u8g2.setCursor(0,20);
  u8g2.print(voltage_value2,2);
  u8g2.print("A");

    u8g2.setCursor(0,30);
  u8g2.print(voltage_value3,2);
  u8g2.print("V");
  u8g2.sendBuffer();
  
  beforemillis=millis();
}
  
 

  if (currentmode>0)
  {
    if (currentmode==1) //CV
    {
      if (currentval>0) 
      {
        if ((currentval==1)&&(voltage_value<(12.6+0.08)))  { currentstep++;ledcWrite(0, currentstep); }
        if ((currentval==1)&&(voltage_value>(12.6+0.08)))  { currentstep--;ledcWrite(0, currentstep); }
         if ((currentval==2)&&(voltage_value<(13.3+0.08)))  { currentstep++;ledcWrite(0, currentstep); }
        if ((currentval==2)&&(voltage_value>(13.3+0.08)))  { currentstep--;ledcWrite(0, currentstep); }
      }
      else 
      { currentstep=1;ledcWrite(0, currentstep); }
    }

      if (currentmode==2) //CC
    {
      if (currentval>0) 
      {
        if ((currentval==1)&&(voltage_value2<0.2))  { currentstep++;ledcWrite(0, currentstep); }
        if ((currentval==1)&&(voltage_value2>0.2))  { currentstep--;ledcWrite(0, currentstep); }
        if ((currentval==2)&&(voltage_value2<0.5))  { currentstep++;ledcWrite(0, currentstep); }
        if ((currentval==2)&&(voltage_value2>0.5))  { currentstep--;ledcWrite(0, currentstep); }
      }
      else 
      { currentstep=1;ledcWrite(0, currentstep); }
    }
    
  }
  else
  {
    currentstep=1;ledcWrite(0, 1); //OFF
  }
  
   //delay(5);
}
